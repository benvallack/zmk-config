## config/west.yml
```yaml
manifest:
  remotes:
    - name: zmkfirmware
      url-base: https://github.com/zmkfirmware
    - name: krikun98
      url-base: https://github.com/krikun98
  projects:
    - name: zmk
      remote: krikun98
      revision: mouse-pr
      import: app/west.yml
  self:
    path: config
```
